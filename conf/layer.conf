## conf/layer.conf
```bitbake
# We have a conf and classes directory, add to BBPATH
BBPATH .= ":${LAYERDIR}"

# We have a packages directory, add to BBFILES
BBFILES += "${LAYERDIR}/recipes-*/*/*.bb \
            ${LAYERDIR}/recipes-*/*/*.bbappend"

BBFILE_COLLECTIONS += "rock64"
BBFILE_PATTERN_rock64 := "^${LAYERDIR}/"
BBFILE_PRIORITY_rock64 = "6"

LAYERSERIES_COMPAT_rock64 = "warrior dunfell"
```

## conf/machine/rock64.conf
```bitbake
#@TYPE: Machine
##@NAME: rock64
#@SOC: Rockchip RK3328
##@DESCRIPTION: Machine configuration for the Rock64

SOC_FAMILY = "rk3328"

require conf/machine/include/tune-cortexa53.inc
# require conf/machine/include/arm/arch-armv8.inc
require conf/machine/include/soc-family.inc
require conf/machine/include/rock64.inc

MACHINEOVERRIDES =. "mali-gpu:mali-utgard:"

PREFERRED_PROVIDER_virtual/kernel = "linux-ayufan"
# PREFERRED_VERSION_linux-rockchip = "4.4"
# PREFERRED_VERSION_linux-rockchip = "4.4.167"
# PREFERRED_VERSION_linux-rockchip = "4.4.193"

KERNEL_DEVICETREE = "rockchip/rk3328-rock64.dtb"
KERNEL_IMAGETYPE = "Image"
# KERNEL_BOOTCMD = "booti"
SERIAL_CONSOLES = "1500000;ttyS2"
KBUILD_DEFCONFIG = "rockchip_linux_defconfig"

PREFERRED_PROVIDER_virtual/bootloader = "u-boot-rockchip"
# PREFERRED_PROVIDER_virtual/bootloader = "u-boot-ayufan"
UBOOT_MACHINE = "rock64-rk3328_defconfig"
# TPL_BINARY ?= "u-boot-tpl.bin"
# SPL_BINARY ?= "u-boot-spl.bin"
# UBOOT_ELF ?= "BL31.elf"

# PARTITION_TABLE_TYPE = "gpt"

# IMAGE_FSTYPES += "rockchip-gpt-img"
# IMAGE_CLASSES += "rockchip-gpt-img"

# MACHINE_ESSENTIAL_EXTRA_RRECOMMENDS += "bluetooth-rk linux-firmware-rtl8723b"
# MACHINE_ESSENTIAL_EXTRA_RDEPENDS += "kernel-devicetree rkbin-wifi"

MACHINE_ESSENTIAL_EXTRA_RRECOMMENDS += " kernel-modules"
```
